## sdk/os/kernel-2.6.32/arch/arm/mach-gpl32900/Kconfig
```kconfig
if ARCH_GPL32900

menu "GPL32900 Options"

config MACH_GPL32900
	bool "GPL32900 (Platform)"
	select CPU_V6

config SERIAL_GPL32900
	bool "GPL32900 serial port support"
	depends on ARM && ARCH_GPL32900
	select SERIAL_CORE
	help
	  ABCDEF

config SERIAL_GPL32900_CONSOLE
	bool "Console on GPL32900 serial port"
	depends on SERIAL_GPL32900
	select SERIAL_CORE_CONSOLE
	help
    ABCDE

config DEFCONFIG_GPL32900
	string "Kernel defconfig file"

endmenu
endif
```

## sdk/os/kernel-2.6.32/arch/arm/mach-spmp8050/Kconfig
```kconfig
if ARCH_SPMP8050

menu "SPMP8050 Options"

config MACH_SPMP8050
	bool "spmp8050 (Platform)"
	select CPU_ARM926T

config SERIAL_SPMP8050
	bool "SPMP8050 serial port support"
	depends on ARM && ARCH_SPMP8050
	select SERIAL_CORE
	help
	  ABCDEF

config SERIAL_SPMP8050_CONSOLE
	bool "Console on SPMP serial port"
	depends on SERIAL_SPMP8050
	select SERIAL_CORE_CONSOLE
	help
    ABCDE

config DEFCONFIG_SPMP8050
	string "Kernel defconfig file"

endmenu
endif
```

## sdk/os/kernel-2.6.32/arch/arm/mach-spmp8050/os/Kconfig
```kconfig
config SPMP8050_ROS
	tristate "Support for ROS API"
	depends on ARCH_SPMP8050
	default m
```
